#include "ff.h"
#include "BMP.h"
#include "GlobalVar.h"

void OLED_Write_Int(unsigned char x,unsigned char y,signed int Number);
signed int Int_To_String(signed long Int_Num,signed char String[]);
FIL bmpfsrc, bmpfdst; 
FRESULT bmpres;
FATFS fs;			/* 文件系统对象 */

//灰度调色板数组                
uint8 Color_Palette[]=
{
 0,0,0,0,1,1,1,0,2,2,2,0,3,3,3,0,4,4,4,0,5,5,5,0,6,6,6,0,7,7,7,0,
8,8,8,0,9,9,9,0,10,10,10,0,11,11,11,0,12,12,12,0,13,13,13,0,14,14,14,0,15,15,15,0,
16,16,16,0,17,17,17,0,18,18,18,0,19,19,19,0,20,20,20,0,21,21,21,0,22,22,22,0,23,23,23,0,
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248,248,248,0,249,249,249,0,250,250,250,0,251,251,251,0,252,252,252,0,253,253,253,0,254,254,254,0,255,255,255,0
};
int image_count = 0;            //截图计数

int SD_Gather_Gray_Picture120x188(void) //采图函数
{
  int temp_count = image_count;
  char name[20] = "0000.bmp";
  name[3] = temp_count % 10 + '0';
  temp_count /= 10;
  name[2] = temp_count % 10 + '0';
  temp_count /= 10;
  name[1] = temp_count % 10 + '0';
  temp_count /= 10;
  name[0] = temp_count % 10 + '0';
  if(0 == Screen_Shot(0,0,188,120,name))
  {
    OLED_Write_Int(6,8,image_count);
    image_count++;
    return 1;
  }
  else 
  {
    OLED_Write_Int(0,0,0);
    return 0;
  }
}

void SD_BMP_Init(void)          //SD卡初始化
{
  bmpres = f_mount(0,&fs);  
  OLED_Write_Int(0,0,bmpres);
//  int temp_count = 0;
//  while(1)
//  {
//    char name[20] = "0000.bmp";
//    name[3] = temp_count % 10 + '0';
//    temp_count /= 10;
//    name[2] = temp_count % 10 + '0';
//    temp_count /= 10;
//    name[1] = temp_count % 10 + '0';
//    temp_count /= 10;
//    name[0] = temp_count % 10 + '0';
//    if (f_unlink(name))
//      break;
//    temp_count++;
//  }
}
/**
 * @brief  设置截取BMP图片
 * @param  x ：截取区域的起点X坐标 
 * @param  y ：截取区域的起点Y坐标 
 * @param  Width ：区域宽度
 * @param  Height ：区域高度 
 * @retval 无
  *   该参数为以下值之一：
  *     @arg 0 :截图成功
  *     @arg -1 :截图失败
 */
int Screen_Shot( uint16_t x, uint16_t y, uint16_t Width, uint16_t Height, char * filename)
{
	/* bmp  文件头 54个字节 */
	unsigned char header[54] =
	{
		0x42, 0x4d, 0, 0, 0, 0, 
		0, 0, 0, 0, 0x36, 0x04,
		0, 0, 40,0, 0, 0, 
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		0, 0, 0
	};
	
	int i;
	int j;
	long file_size;     
	long width;
	long height;
	unsigned int mybw;
	unsigned char read_data;
	char kk[4]={0,0,0,0};
	
	uint8_t ucAlign;//
	
	
	/* 宽*高 +补充的字节 + 头部信息 */
        file_size = (long)Width * (long)Height + 54 + 1024;

	/* 文件大小 4个字节 */
	header[2] = (unsigned char)(file_size &0x000000ff);
	header[3] = (file_size >> 8) & 0x000000ff;
	header[4] = (file_size >> 16) & 0x000000ff;
	header[5] = (file_size >> 24) & 0x000000ff;
	
	/* 位图宽 4个字节 */
	width=Width;	
	header[18] = width & 0x000000ff;
	header[19] = (width >> 8) &0x000000ff;
	header[20] = (width >> 16) &0x000000ff;
	header[21] = (width >> 24) &0x000000ff;
	
	/* 位图高 4个字节 */
	height = Height;
	header[22] = height &0x000000ff;
	header[23] = (height >> 8) &0x000000ff;
	header[24] = (height >> 16) &0x000000ff;
	header[25] = (height >> 24) &0x000000ff;
		
	/* 新建一个文件 */
	bmpres = f_open( &bmpfsrc , (char*)filename, FA_CREATE_ALWAYS | FA_WRITE );
	
	/* 新建文件之后要先关闭再打开才能写入 */
	f_close(&bmpfsrc);
		
	bmpres = f_open( &bmpfsrc , (char*)filename,  FA_OPEN_EXISTING | FA_WRITE);

	if ( bmpres == FR_OK )
	{    
		/* 将预先定义好的bmp头部信息写进文件里面 */
		bmpres = f_write(&bmpfsrc, header,sizeof(unsigned char)*54, &mybw);		
		/* 将灰度调色板信息写进文件里面 */
                bmpres = f_write(&bmpfsrc, Color_Palette, sizeof(unsigned char) * 1024, &mybw);
		ucAlign = Width % 4;
		
		for(i=0; i<Height; i++)					
		{
			for(j=0; j<Width; j++)  
			{					
				read_data = image[y + Height - 1 - i][x + j];					
				bmpres = f_write(&bmpfsrc, &read_data, sizeof(unsigned char), &mybw);
			}
				
			if( ucAlign )				/* 如果不是4字节对齐 */
				bmpres = f_write ( & bmpfsrc, kk, sizeof(unsigned char) * ( ucAlign ), & mybw );

		}/* 截屏完毕 */

		f_close(&bmpfsrc); 
		
		return 0;
		
	}	
	else/* 截屏失败 */
		return -1;

}

